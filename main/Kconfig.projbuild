## main/Kconfig.projbuild
```kconfig
menu "Drone Configuration"

    choice EXAMPLE_IP_MODE
        prompt "IP Version"
        depends on EXAMPLE_SOCKET_IP_INPUT_STRING
        help
            Example can use either IPV4 or IPV6.

        config EXAMPLE_IPV4
            bool "IPV4"

        config EXAMPLE_IPV6
            bool "IPV6"
            select EXAMPLE_CONNECT_IPV6

    endchoice

    config WIFI_SSID
        string "Wifi SSID"
        default "YOUR_WIFI_SSID"
        help
            Name of wifi hotspot.

    config WIFI_PASSWORD
        string "Wifi Password"
        default "YOUR_WIFI_PASSWORD"
        help 
            Wifi hotspot password.

    config WIFI_STATIC_IP
        bool "Use a static IPv4 address for the drone"
        default n
        help
            Disable DHCP and use the drone address, gateway, and subnet mask
            below. Choose an unused address on the access point's subnet and
            reserve it or exclude it from the access point's DHCP pool.
            This does not change the laptop telemetry destination.

    config DRONE_STATIC_IPV4_ADDR
        string "Drone static IPv4 address"
        depends on WIFI_STATIC_IP
        default "192.0.2.2"

    config WIFI_STATIC_GATEWAY
        string "Static IPv4 gateway"
        depends on WIFI_STATIC_IP
        default "192.0.2.1"

    config WIFI_STATIC_NETMASK
        string "Static IPv4 subnet mask"
        depends on WIFI_STATIC_IP
        default "255.255.255.0"

    config HOST_IPV4_ADDR
        string "Laptop telemetry destination IPv4 address"
        default "192.0.2.1"
        help
            IPv4 address of the laptop that receives telemetry. This is
            separate from the drone's own static or DHCP-assigned address.

    config TOF_BRIDGE_PORT
        int "TOF bridge port (outgoing)"
        range 0 65535
        default 3333
        help
          Port number to send TOF data to (outgoing data)

    config MAVROS_BRIDGE_IN_PORT
        int "Mavros bridge port (incoming)"
        range 0 65535
        default 8888
        help
          Port number for central compute to send mavlink packets to (incoming data)

    config MAVROS_BRIDGE_OUT_PORT
        int "Mavros bridge port (outgoing)"
        range 0 65535
        default 14550
        help
          Port number for central compute to send mavlink packets to (incoming data)

    config APRILTAG_SEND_PORT
        int "Port to send apriltag messages to"
        range 0 65535
        default 5000
        help
          Port to send apriltag messages to

    config APRILTAG_CAMERA_ENABLED
        bool "Enable AprilTag camera task"
        default n
        help
          Start the camera and AprilTag detector on Core 1. Leave this disabled
          while validating the Core 0 ToF and NanoSLAM pipeline. The
          camera state APIs remain initialized and report no detections, so
          telemetry callers can continue safely. In bench mode, disabling this
          option leaves Core 1 available for future camera work.

    config DRONE_ID
        int "Drone ID (0-30)"
        range 0 30
        default 0
        help
          Unique identifier for this drone. Used in telemetry packets.

    config TELEM_PORT
        int "Telemetry UDP port (outgoing)"
        range 0 65535
        default 5005
        help
          UDP port on the laptop that receives telemetry packets.

    config EXPERIMENT_MISSION_ENABLED
        bool "Use staged rectangle experiment mission instead of exploration"
        default n
        help
          In flight builds, use the onboard takeoff/rectangle/land state machine.
          The laptop must explicitly submit an experiment command. Bench builds
          always remain passive. No navigation task runs in this mode.

    config NANOSLAM_ENABLED
        bool "Run the NanoSLAM task (ICP + pose-graph optimisation)"
        default y
        help
          Records a pose and a 400 ms ToF scan every NANOSLAM_RECORD_INTERVAL_MS
          while armed, runs ICP + LS-SLAM in the background, and after
          disarming sends the optimised graph to the laptop over Wi-Fi, where
          laptop/nanoslam_receive.py builds the map. It never sends setpoints
          and does not feed navigation.

    config EXPERIMENT_WITHOUT_TOF
        bool "Disable ToF acquisition and obstacle checks for baseline flights"
        depends on EXPERIMENT_MISSION_ENABLED && !NANOSLAM_ENABLED && !BENCH_MODE
        default n
        help
          Only for staged takeoff/land and rectangle flight baselines. Do not
          initialize or start the ToF acquisition task. Experiment arming and
          flight health checks then require PX4 telemetry and clock sync only;
          there is no ToF obstacle protection. Telemetry reports grid/rate 0/0.

    config EXPERIMENT_OBSTACLE_ABORT
        bool "Abort experiment rectangles when ToF sees an obstacle within 0.4 m"
        depends on EXPERIMENT_MISSION_ENABLED && !EXPERIMENT_WITHOUT_TOF
        default n
        help
          Off by default for recording runs flown over a verified-clear area:
          single noisy ToF zones caused false aborts. ToF freshness, PX4
          telemetry and clock-sync health checks still abort when off.

    config TOF_GRID_SIZE
        int "Native ToF grid width (4 or 8)"
        range 4 8
        default 8

    config TOF_RATE_HZ
        int "Native ToF rate (Hz)"
        range 1 60
        default 15

    config TOF_INTEGRATION_MS
        int "ToF integration time (ms)"
        range 2 100
        default 5
        help
          Per-frame integration time of each VL53L5CX (autonomous mode). Longer
          integration collects more signal, so farther and darker surfaces
          return a target instead of "no target", at slightly higher power. It
          must leave a few ms of each frame period: at most 1000/TOF_RATE_HZ - 6
          (60 ms at 15 Hz, 27 ms at 30 Hz). ST's default is 20 ms.

    config DATA_TELEM_HZ
        int "Laptop PX4 telemetry snapshot rate (Hz)"
        range 10 100
        default 50

    config TOF_LEGACY_DEBUG
        bool "Also send legacy 8x8 heatmap snapshots at 10 Hz"
        default y
        help
          Only emitted for 8x8 profiles. Native recording packets are queued
          separately and include timing, clock synchronization and loss counters.

    config TOF_FRONT_SENSOR_IDX
        int "Front-facing ToF sensor index (0-7)"
        range 0 7
        default 0
        help
          Which sensor (0-7) physically faces forward.
          Sensors are mounted counter-clockwise, so sensor (N+1) is 45 deg to
          the LEFT of sensor N.  Set this to the index of the sensor that faces
          the drone's nose.

    config TCA_SDA_GPIO_PORT
        int "GPIO I2C SDA"
        range 0 50
        default 1
        help
          GPIO Port of the TCA SDA

    config TCA_SCL_GPIO_PORT
        int "GPIO I2C SCL"
        range 0 50
        default 2
        help
          GPIO Port of the TCA SCL

    config PX4_TX_PIN 
        int "GPIO PX4 TX PIN"
        range 0 50
        default 5
        help
          GPIO PX4 TX PIN

    config PX4_RX_PIN 
        int "GPIO PX4 RX PIN"
        range 0 50
        default 4
        help
          GPIO PX4 RX PIN

    config PX4_POSE_RATE_HZ
        int "PX4 position/attitude stream rate (Hz)"
        range 5 100
        default 20
        help
          Rate requested from PX4 for LOCAL_POSITION_NED, ATTITUDE and
          ATTITUDE_QUATERNION. This does not change setpoint behaviour.

    config BENCH_MODE
        bool "Props-off bench mode"
        default y
        help
          Keep telemetry, ToF, Wi-Fi, and NanoSLAM active, but do not spawn the
          navigation or mission tasks and never publish setpoints. Camera
          detection is controlled separately by APRILTAG_CAMERA_ENABLED.
          Disable only after props-off validation and a flight-readiness review.

    config NANOSLAM_RECORD_INTERVAL_MS
        int "NanoSLAM pose + scan interval (ms)"
        depends on NANOSLAM_ENABLED
        range 600 10000
        default 1500
        help
          One graph node and one 400 ms scan per interval. The graph holds 64
          nodes, so 1500 ms covers 96 s of flight.

    config NANOSLAM_INFLIGHT_EVERY_N
        int "Optimise in flight every N poses (0 = only after landing)"
        depends on NANOSLAM_ENABLED
        range 0 64
        default 5

    config NANOSLAM_MAX_SHIFT_CM
        int "Reject an in-flight optimisation that moves the newest pose by more than (cm)"
        depends on NANOSLAM_ENABLED
        range 5 500
        default 50
        help
          Protects the live map frame from a bad loop closure. The
          post-flight optimisation is not limited.

    config NANOSLAM_RECORD_DISARMED
        bool "Also record while disarmed (hand-carried bench tests)"
        depends on NANOSLAM_ENABLED
        default n
        help
          Record from boot without arming. When the graph is full the result is
          optimised and uploaded once. Arming still starts a fresh graph.

    config NANOSLAM_ICP_POINT_TO_LINE
        bool "Use point-to-line ICP (as laptop/offline_slam.py)"
        depends on NANOSLAM_ENABLED
        default y
        help
          Matches each new scan to local wall lines in the reference scan
          instead of to individual points. Removes the sideways bias of
          ETH/Duncan's point-to-point ICP on walls and rejects single-wall
          scans. Disable to use the original point-to-point ICP.

    config NANOSLAM_ETH_WEIGHTS
        bool "Use ETH/Duncan's original edge weights (for comparison)"
        depends on NANOSLAM_ENABLED
        default n
        help
          Off (default): odometry edges come from the raw PX4 poses and edges
          are weighted per axis (odometry 8 cm / 1 deg, ICP 3 cm / 3 deg), so
          PX4's precise gyro heading is not overridden by noisy ICP headings.
          On: ICP edges get 20x the information of odometry in every axis, as
          in ETH's code. Odometry edges still come from the raw poses.

    config NANOSLAM_UPLOAD_PORT
        int "Laptop UDP port for the post-flight SLAM upload"
        depends on NANOSLAM_ENABLED
        range 1 65535
        default 5008
        help
          After landing, the optimised graph (raw + optimised poses, scans,
          ICP constraints) is sent to HOST_IPV4_ADDR on this port.
          laptop/nanoslam_receive.py listens there and builds the map.

    config NANOSLAM_UPLOAD_REPEATS
        int "Times the whole upload is sent (UDP has no retransmission)"
        depends on NANOSLAM_ENABLED
        range 1 10
        default 3

    config NANOSLAM_SENSOR_OFFSET_MM
        int "ToF lens distance from the drone centre (mm)"
        depends on NANOSLAM_ENABLED
        range 0 200
        default 37
        help
          Measured 2026-11-07: 39 mm front/back/left/right, 33.5 mm diagonals.

endmenu
```
